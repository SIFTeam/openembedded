## conf/machine/dm500hd.conf
```bitbake
#@TYPE: Machine
#@NAME: Dreambox DM 500HD PVR
#@DESCRIPTION: Machine configuration for the Dreambox DM 500HD PVR

PREFERRED_VERSION_wpa-supplicant = "0.5.10"

#needed for wpa-supplicant (0.6.9)
COMBINED_FEATURES_append = "${@base_contains('PREFERRED_VERSION_linux-${MACHINE}', '2.6.18', '', 'nl80211', d)}"

#take care when you do changes on MACHINE_ESSENTIAL_EXTRA_RDEPENDS/RRECOMMENDS you have to increment the recipes/tasks/task-boot.bb PR

MACHINE_ESSENTIAL_EXTRA_RDEPENDS = "\
	kernel-module-nls-iso8859-1 \
	kernel-module-nls-iso8859-15 \
	kernel-module-nls-cp437 \
	kernel-module-nls-cp850 \
	kernel-module-nls-utf8 \
"

module_autoload_nls-iso8859-1 = "nls-iso8859-1"
module_autoload_nls-iso8859-15 = "nls-iso8859-15"
module_autoload_nls-cp437 = "nls-cp437"
module_autoload_nls-cp850 = "nls-cp850"
module_autoload_nls-utf8 = "nls-utf8"

MACHINE_ESSENTIAL_EXTRA_RRECOMMENDS = "\
	kernel-module-cifs \
	kernel-module-exportfs \
	kernel-module-ext2 \
	kernel-module-xfs \
	kernel-module-iso9660 \
	kernel-module-udf \
	kernel-module-cdfs \
"

module_autoload_cifs = "cifs"
module_autoload_exportfs = "exportfs"
module_autoload_ext2 = "ext2"
module_autoload_xfs = "xfs"
module_autoload_iso9660 = "iso9660"
module_autoload_udf = "udf"
module_autoload_cdfs = "cdfs"
module_autoload_ntfs = "ntfs"

MACHINE_EXTRA_RRECOMMENDS = " \
	gst-plugin-dvbmediasink \
	dreambox-tpmd \
	dreambox-keymaps \
	"

KERNEL_EXTRA_CMD = "--disable-compressor=lzo "

EXTRA_IMAGECMD_jffs2 = " --eraseblock=0x4000 -n -l "
IMAGE_CMD_jffs2 = "\
	mkfs.jffs2 \
		--root=${IMAGE_ROOTFS}/boot \
		--faketime \
		--disable-compressor=lzo \
		--compression-mode=size \
		--output=${DEPLOY_DIR_IMAGE}/${IMAGE_NAME}.boot.jffs2 \
		${EXTRA_IMAGECMD}; \
	rm -rf ${IMAGE_ROOTFS}/boot/*; \
	mkfs.jffs2 \
		--root=${IMAGE_ROOTFS} \
		--faketime \
		${KERNEL_EXTRA_CMD} \
		--compression-mode=size \
		--output=${DEPLOY_DIR_IMAGE}/${IMAGE_NAME}.rootfs.jffs2 \
		${EXTRA_IMAGECMD}; \
	buildimage ${STAGING_LIBDIR}/dreambox-secondstage/main.bin.gz \
		${DEPLOY_DIR_IMAGE}/${IMAGE_NAME}.boot.jffs2 \
		${DEPLOY_DIR_IMAGE}/${IMAGE_NAME}.rootfs.jffs2 \
		${MACHINE} 64 \
		> ${DEPLOY_DIR_IMAGE}/${IMAGE_NAME}.nfi"

TARGET_FPU = "hard"

MACHINE_FEATURES += "modem"

# openpli specific features:
MACHINE_FEATURES += "32bpp hdtv switchoff lpcm dvb-c blindscan"

require conf/machine/include/dreambox-mipsel.inc
```

## conf/machine/dm7020hd.conf
```bitbake
#@TYPE: Machine
#@NAME: Dreambox DM7020HD
#@DESCRIPTION: Machine configuration for the Dreambox DM7020HD

PREFERRED_VERSION_wpa-supplicant = "0.5.8"

#take care when you do changes on MACHINE_ESSENTIAL_EXTRA_RDEPENDS/RRECOMMENDS you have to increment the recipes/tasks/task-boot.bb PR

MACHINE_ESSENTIAL_EXTRA_RDEPENDS = "\
	kernel-module-nls-iso8859-1 \
	kernel-module-nls-iso8859-15 \
	kernel-module-nls-cp437 \
	kernel-module-nls-cp850 \
	kernel-module-nls-utf8 \
	v4l-dvb-module-dvb-core \
	v4l-dvb-module-stv0299 \
"

module_autoload_nls-iso8859-1 = "nls-iso8859-1"
module_autoload_nls-iso8859-15 = "nls-iso8859-15"
module_autoload_nls-cp437 = "nls-cp437"
module_autoload_nls-cp850 = "nls-cp850"
module_autoload_nls-utf8 = "nls-utf8"
module_autoload_dvb-core = "dvb-core"
module_autoload_stv0299 = "stv0299"

MACHINE_ESSENTIAL_EXTRA_RRECOMMENDS = "\
	kernel-module-cifs \
	kernel-module-exportfs \
	kernel-module-ext2 \
	kernel-module-ntfs \
	kernel-module-iso9660 \
	kernel-module-udf \
	kernel-module-cdfs \
"

module_autoload_cifs = "cifs"
module_autoload_exportfs = "exportfs"
module_autoload_ext2 = "ext2"
module_autoload_xfs = "xfs"
module_autoload_iso9660 = "iso9660"
module_autoload_udf = "udf"
module_autoload_cdfs = "cdfs"
module_autoload_ntfs = "ntfs"

MACHINE_EXTRA_RRECOMMENDS = " \
	gst-plugin-dvbmediasink \
	dreambox-tpmd \
	dreambox-boot-progress \
	dreambox-enigma2-config \
	"

DVBMEDIASINK_CONFIG = "--with-dtsdownmix"

EXTRA_IMAGEDEPENDS += "dreambox-enigma2-config"

KERNEL_EXTRA_CMD = "--disable-compressor=lzo "

EXTRA_IMAGECMD_jffs2 = " -e 0x40000 -n -l"
IMAGE_CMD_jffs2 = "\
	mkfs.jffs2 \
		--root=${IMAGE_ROOTFS}/boot \
		--faketime \
		--disable-compressor=lzo \
		--compression-mode=size \
		--output=${DEPLOY_DIR_IMAGE}/${IMAGE_NAME}.boot.jffs2 \
		${EXTRA_IMAGECMD}; \
	rm -rf ${IMAGE_ROOTFS}/boot/*; \
	mkfs.jffs2 \
		--root=${IMAGE_ROOTFS} \
		--faketime \
		${KERNEL_EXTRA_CMD} \
		--compression-mode=size \
		--output=${DEPLOY_DIR_IMAGE}/${IMAGE_NAME}.rootfs.jffs2 \
		${EXTRA_IMAGECMD}; \
	sumtool \
		-i ${DEPLOY_DIR_IMAGE}/${IMAGE_NAME}.rootfs.jffs2 \
		-o ${DEPLOY_DIR_IMAGE}/${IMAGE_NAME}.rootfs.jffs2.sum \
		${EXTRA_IMAGECMD}; \
	buildimage --brcmnand --arch ${MACHINE} -e 0x40000 -f 0x10000000 -s 4096 \
		-b 0x100000:${STAGING_LIBDIR}/dreambox-secondstage/main.bin.gz \
		-d 0x700000:${DEPLOY_DIR_IMAGE}/${IMAGE_NAME}.boot.jffs2 \
		-d 0xF800000:${DEPLOY_DIR_IMAGE}/${IMAGE_NAME}.rootfs.jffs2.sum \
		> ${DEPLOY_DIR_IMAGE}/${IMAGE_NAME}.nfi"

MACHINE_FEATURES += "usbhost modem wifi"

# openpli specific features:
MACHINE_FEATURES += "32bpp hdtv switchoff lpcm dvb-c dvbapi5 tpm"

# wifiusblegacy enables legacy external usb wlan drivers
MACHINE_FEATURES += "wifiusblegacy"

CHIPSET = "bcm7405"

require conf/machine/include/dreambox-mipsel.inc
include conf/machine/include/autoload-usbserial.inc

SYSVINIT_ENABLED_GETTYS = ""
```

## conf/machine/dm7025.conf
```bitbake
#@TYPE: Machine
#@NAME: Dreambox DM 7025 PVR
#@DESCRIPTION: Machine configuration for the Dreambox DM 7025 PVR

#take care when you do changes on MACHINE_ESSENTIAL_EXTRA_RDEPENDS/RRECOMMENDS you have to increment the recipes/tasks/task-boot.bb PR

# No 2.6.18 kernel for the 7025 (note: gets replaced by include...)
PREFERRED_VERSION_linux-${MACHINE} = "2.6.12.6"
#PREFERRED_VERSION_linux-libc-headers = "2.6.12.0"
PREFERRED_VERSION_unionfs-modules = "1.1.5"
PREFERRED_VERSION_wpa-supplicant = "0.5.8"

MACHINE_KERNEL_PR = "r9.3"

EXTRA_IMAGEDEPENDS += "\
	${@base_contains('PREFERRED_VERSION_linux-dm7025', '2.6.12.6', 'unionfs-modules hotplug-ng', 'squashfs-tools-native', d)} \
	dreambox-boottool \
	enigma2-plugin-systemplugins-flashextender \
	dreambox-boottool-cf \
	enigma2-plugin-systemplugins-cfboot \
	dreambox-enigma2-config \
"

MACHINE_ESSENTIAL_EXTRA_RDEPENDS = "\
	kernel-module-squashfs \
	kernel-module-unlzma \
	kernel-module-sqlzma \
	${@base_contains('PREFERRED_VERSION_linux-dm7025', '2.6.12.6', 'unionfs-modules hotplug-ng', 'kernel-module-unionfs \
		kernel-module-ext3 \
		kernel-module-nls-iso8859-15 \
		kernel-module-nls-iso8859-1 \
		kernel-module-nls-cp437 \
		kernel-module-nls-cp850 \
		kernel-module-nls-utf8', d)} \
	dreambox-boottool \
"


#module_autoload_stv0299 = "stv0299"
#module_autoload_nls-iso8859-1 = "nls-iso8859-1"
#module_autoload_nls-iso8859-15 = "nls-iso8859-15"
#module_autoload_nls-cp437 = "nls-cp437"
#module_autoload_nls-cp850 = "nls-cp850"
#module_autoload_nls-utf8 = "nls-utf8"

#module_autoload_cifs = "cifs"
#module_autoload_exportfs = "exportfs"
#module_autoload_ext2 = "ext2"
module_autoload_xfs = "xfs"
#module_autoload_iso9660 = "iso9660"
#module_autoload_udf = "udf"
#module_autoload_cdfs = "cdfs"
#module_autoload_ntfs = "ntfs"

MACHINE_EXTRA_RRECOMMENDS = " \
	mdev-static-devices \
	gst-plugin-dvbmediasink \
	dreambox-boot-progress \
	enable-dma-mode \
	unionfs-utils \
	dreambox-enigma2-config \
	"

DVBMEDIASINK_CONFIG = "--without-mpeg4 --without-mpeg4v2 --without-h264 --without-h263 --without-mp3 --without-dts --without-lpcm"

#KERNEL_EXTRA_CMD = "--disable-compressor=lzo "

# A list of files/dirs that should be in uncompressed space
# Can be files or directories, but not wildcards
DONT_SQUASH_LIST = "\
	home media mnt hdd \
	etc/tuxbox etc/dropbear etc/rcS.d etc/samba etc/group etc/passwd \
	usr/lib/opkg/status var/lib \
	usr/lib/enigma2 usr/share/enigma2 usr/bin/enigma2 usr/bin/enigma2.sh \
	usr/lib/libopen.so.0.0.0 usr/lib/libopen.so.0 \
	"

KV = "${@base_contains('PREFERRED_VERSION_linux-dm7025', '2.6.12.6', '2.6.12.6', '${PREFERRED_VERSION_linux-dm7025}-1.3-dm7025', d)}"
UNIONFS = "${@base_contains('PREFERRED_VERSION_linux-dm7025', '2.6.12.6', 'unionfs.ko', 'unionfs', d)}"
MKSQUASHFS_PARAM = "${@base_contains('PREFERRED_VERSION_linux-dm7025', '2.6.12.6', '-le', '-comp lzma', d)}"

UNLZMA_CMD = "${@base_contains('PREFERRED_VERSION_linux-dm7025', '2.6.12.6', '', \
	'mv ${IMAGE_ROOTFS}/lib/modules/${KV}/kernel/lib/decompress_unlzma.ko \
	${IMAGE_ROOTFS}/boot/lib/modules/${KV}/kernel/lib;', d)}"

EXTRA_IMAGECMD_jffs2 = " --eraseblock=0x4000 -n -l "
IMAGE_CMD_jffs2 = "\
	install -d ${DEPLOY_DIR_IMAGE}/boot_tmp; \
	for i in bin dev mnt/flash mnt/squashfs mnt/root; \
	do \
		install -d ${IMAGE_ROOTFS}/boot/$i; \
	done; \
	install -d ${IMAGE_ROOTFS}/boot/lib/modules/${KV}/kernel/fs; \
	install -d ${IMAGE_ROOTFS}/boot/lib/modules/${KV}/kernel/drivers/block; \
	install -d ${IMAGE_ROOTFS}/boot/lib/modules/${KV}/kernel/lib; \
	mv ${IMAGE_ROOTFS}/lib/modules/${KV}/kernel/fs/squashfs \
		${IMAGE_ROOTFS}/boot/lib/modules/${KV}/kernel/fs; \
	mv ${IMAGE_ROOTFS}/lib/modules/${KV}/kernel/fs/${UNIONFS} \
		${IMAGE_ROOTFS}/boot/lib/modules/${KV}/kernel/fs; \
	${UNLZMA_CMD} \
	mknod -m 660 ${IMAGE_ROOTFS}/boot/dev/console c 5 1; \
	mknod -m 660 ${IMAGE_ROOTFS}/boot/dev/null c 1 3; \
	mknod -m 660 ${IMAGE_ROOTFS}/boot/dev/mtdblock3 b 31 3; \
	mknod -m 660 ${IMAGE_ROOTFS}/boot/dev/loop0 b 7 0; \
	mkfs.jffs2 \
		--root=${IMAGE_ROOTFS}/boot \
		--faketime \
		--disable-compressor=lzo \
		--compression-mode=size \
		--output=${DEPLOY_DIR_IMAGE}/${IMAGE_NAME}.boot.jffs2 \
		${EXTRA_IMAGECMD}; \
	rm -rf ${DEPLOY_DIR_IMAGE}/boot_tmp; \
	mv ${IMAGE_ROOTFS}/boot ${DEPLOY_DIR_IMAGE}/boot_tmp; \
	install -d ${IMAGE_ROOTFS}/boot; \
	\
	rm -rf ${DEPLOY_DIR_IMAGE}/${IMAGE_NAME}/delta; \
	install -d ${DEPLOY_DIR_IMAGE}/${IMAGE_NAME}/delta; \
	cd ${IMAGE_ROOTFS}; \
	for i in ${DONT_SQUASH_LIST} ; \
	do \
		j=`dirname $i` ; \
		install -d ${DEPLOY_DIR_IMAGE}/${IMAGE_NAME}/delta/${j}; \
		mv $i ${DEPLOY_DIR_IMAGE}/${IMAGE_NAME}/delta/${j}; \
	done; \
	sed -i 's/^\/dev\/mtdblock2/\/dev\/root/;' ${IMAGE_ROOTFS}/etc/fstab; \
	mksquashfs ${IMAGE_ROOTFS}/* ${DEPLOY_DIR_IMAGE}/${IMAGE_NAME}/squashfs \
		${MKSQUASHFS_PARAM} -root-owned -noappend; \
	\
	mkfs.jffs2 \
		--root=${DEPLOY_DIR_IMAGE}/${IMAGE_NAME} \
		--faketime \
		--disable-compressor=lzo \
		--compression-mode=size \
		--output=${DEPLOY_DIR_IMAGE}/${IMAGE_NAME}.rootfs.jffs2 \
		${EXTRA_IMAGECMD}; \
	for i in ${DEPLOY_DIR_IMAGE}/${IMAGE_NAME}/delta/*; \ 
		do cp -R $i ${IMAGE_ROOTFS}; done; \
	rm -rf ${DEPLOY_DIR_IMAGE}/${IMAGE_NAME}; \
	rm -rf ${IMAGE_ROOTFS}/boot; \
	mv ${DEPLOY_DIR_IMAGE}/boot_tmp ${IMAGE_ROOTFS}/boot; \
	buildimage --arch ${MACHINE} -e 0x4000 -f 0x2000000 -s 512 \
		-b 0x40000:${STAGING_LIBDIR}/dreambox-secondstage/main.bin.gz \
		-d 0x3C0000:${DEPLOY_DIR_IMAGE}/${IMAGE_NAME}.boot.jffs2 \
		-d 0x1C00000:${DEPLOY_DIR_IMAGE}/${IMAGE_NAME}.rootfs.jffs2 \
		> ${DEPLOY_DIR_IMAGE}/${IMAGE_NAME}.nfi"

TARGET_FPU = "soft"

MACHINE_FEATURES += "usbhost"

# openpli specific features:
MACHINE_FEATURES += "32bpp switchoff lpcm dvb-c frontprocessor dvbapi3 nohotplug tpm"

CHIPSET = "ati"

require conf/machine/include/dreambox-mipsel.inc
include conf/machine/include/autoload-usbserial.inc

# override it again!
MACHINE_KERNEL_PR = "r9.3"

# No 2.6.18 kernel for the 7025, the includes override it so we override it better
PREFERRED_VERSION_linux-${MACHINE} = "2.6.12.6"
#PREFERRED_VERSION_linux-libc-headers = "2.6.12.0"

# sysvinit: No serial console
SERIAL_CONSOLE = ""

SYSVINIT_ENABLED_GETTYS = ""

# With the move DVBAPI5, the 7025 kernel is too old for the
# code. There's a special branch with the old interface for
# now.
ENIGMA2_BRANCH = "dm7025"
```

## conf/machine/dm800.conf
```bitbake
#@TYPE: Machine
#@NAME: Dreambox DM 800 HD PVR
#@DESCRIPTION: Machine configuration for the Dreambox DM 800 HD PVR

PREFERRED_VERSION_wpa-supplicant = "0.5.8"

#take care when you do changes on MACHINE_ESSENTIAL_EXTRA_RDEPENDS/RRECOMMENDS you have to increment the recipes/tasks/task-boot.bb PR

MACHINE_ESSENTIAL_EXTRA_RDEPENDS = "\
	kernel-module-nls-iso8859-1 \
	kernel-module-nls-iso8859-15 \
	kernel-module-nls-cp437 \
	kernel-module-nls-cp850 \
	kernel-module-nls-utf8 \
	v4l-dvb-module-dvb-core \
	v4l-dvb-module-stv0299 \
"

module_autoload_nls-iso8859-1 = "nls-iso8859-1"
module_autoload_nls-iso8859-15 = "nls-iso8859-15"
module_autoload_nls-cp437 = "nls-cp437"
module_autoload_nls-cp850 = "nls-cp850"
module_autoload_nls-utf8 = "nls-utf8"
module_autoload_dvb-core = "dvb-core"
module_autoload_stv0299 = "stv0299"

MACHINE_ESSENTIAL_EXTRA_RRECOMMENDS = "\
	kernel-module-cifs \
	kernel-module-exportfs \
	kernel-module-ext2 \
	kernel-module-ntfs \
	kernel-module-iso9660 \
	kernel-module-udf \
	kernel-module-cdfs \
"

module_autoload_cifs = "cifs"
module_autoload_exportfs = "exportfs"
module_autoload_ext2 = "ext2"
module_autoload_xfs = "xfs"
module_autoload_iso9660 = "iso9660"
module_autoload_udf = "udf"
module_autoload_cdfs = "cdfs"
module_autoload_ntfs = "ntfs"

MACHINE_EXTRA_RRECOMMENDS = " \
	gst-plugin-dvbmediasink \
	dreambox-tpmd \
	dreambox-boot-progress \
	"

DVBMEDIASINK_CONFIG = "--without-mpeg4v2 --without-dts --without-lpcm"

KERNEL_EXTRA_CMD = "--disable-compressor=lzo "

EXTRA_IMAGECMD_jffs2 = " -e 0x4000 -n -l"
IMAGE_CMD_jffs2 = "\
	mkfs.jffs2 \
		--root=${IMAGE_ROOTFS}/boot \
		--faketime \
		--disable-compressor=lzo \
		--compression-mode=size \
		--output=${DEPLOY_DIR_IMAGE}/${IMAGE_NAME}.boot.jffs2 \
		${EXTRA_IMAGECMD}; \
	rm -rf ${IMAGE_ROOTFS}/boot/*; \
	mkfs.jffs2 \
		--root=${IMAGE_ROOTFS} \
		--faketime \
		${KERNEL_EXTRA_CMD} \
		--compression-mode=size \
		--output=${DEPLOY_DIR_IMAGE}/${IMAGE_NAME}.rootfs.jffs2 \
		${EXTRA_IMAGECMD}; \
	buildimage --brcmnand --arch ${MACHINE} -e 0x4000 -f 0x4000000 -s 512 \
		-b 0x40000:${STAGING_LIBDIR}/dreambox-secondstage/main.bin.gz \
		-d 0x3C0000:${DEPLOY_DIR_IMAGE}/${IMAGE_NAME}.boot.jffs2 \
		-d 0x3C00000:${DEPLOY_DIR_IMAGE}/${IMAGE_NAME}.rootfs.jffs2 \
		> ${DEPLOY_DIR_IMAGE}/${IMAGE_NAME}.nfi"

MACHINE_FEATURES += "usbhost modem wifi"

# openpli specific features:
MACHINE_FEATURES += "32bpp hdtv dvb-c dvbapi5 tpm"

# wifiusblegacy enables legacy external usb wlan drivers
MACHINE_FEATURES += "wifiusblegacy"

CHIPSET = "bcm7401"

require conf/machine/include/dreambox-mipsel.inc
include conf/machine/include/autoload-usbserial.inc

SYSVINIT_ENABLED_GETTYS = ""
```
