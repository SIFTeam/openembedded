## conf/distro/include/openpli-unstable-versions.inc
```bitbake
# git
SRCREV_pn-enigma2-plugin-skins-magic ?= "${AUTOREV}"
SRCREV_pn-enigma2-plugin-skins-magic-hd ?= "fbae89f0a6c8a0ce3a3e8112baa393ec10409044"
SRCREV_pn-enigma2 ?= "${AUTOREV}"
SRCREV_pn-aio-grab ?= "${AUTOREV}"
SRCREV_pn-ambx ?= "${AUTOREV}"
SRCREV_pn-python-pyambx ?= "${AUTOREV}"
SRCREV_pn-enigma2-plugin-extensions-ambx ?= "${AUTOREV}"
SRCREV_pn-enigma2-pliplugins ?= "${AUTOREV}"
SRCREV_pn-enigma2-plugin-extensions-xmltvimport ?= "${AUTOREV}"
SRCREV_pn-enigma2-plugin-extensions-webinterface-old ?= "${AUTOREV}"
SRCREV_pn-enigma2-plugins ?= "${AUTOREV}"
SRCREV_pn-enigma2-skins ?= "${AUTOREV}"
SRCREV_pn-hotplug-e2-helper ?= "${AUTOREV}"
SRCREV_pn-libdreamdvd ?= "${AUTOREV}"
SRCREV_pn-usbtunerhelper ?= "${AUTOREV}"
SRCREV_pn-gst-plugin-dvbmediasink ?= "${AUTOREV}"
SRCREV_pn-libtuxtxt ?= "${AUTOREV}"
SRCREV_pn-tuxtxt-enigma2 ?= "${AUTOREV}"
SRCREV_pn-libdvbsi++ ?= "bf0c2bb7b326b93713629dbf74f63a0a54ffe59d"
SRCREV_pn-gst-plugin-subsink ?= "${AUTOREV}"
SRCREV_pn-librtmp ?= "${AUTOREV}"

# svn
SRCREV_pn-tuxbox-common ?= "${AUTOREV}"
SRCREV_pn-tuxbox-stream ?= "${AUTOREV}"
SRCREV_pn-tuxbox-plugins-enigma ?= "${AUTOREV}"
SRCREV_pn-tuxterm ?= "${AUTOREV}"
SRCREV_pn-db-epg ?= "${AUTOREV}"
SRCREV_pn-plimgr ?= "${AUTOREV}"
SRCREV_pn-scramble ?= "2"
SRCREV_pn-enigma2-plugin-extensions-tuxcom ?= "${AUTOREV}"
SRCREV_pn-enigma2-plugin-extensions-tuxterm ?= "${AUTOREV}"

# cvs
SRCDATE_enigma2-plugins ?= "20101023"
SRCDATE_enigma2-skins ?= "20101023"
SRCDATE_enigma2-streamproxy ?= "20101014"
SRCDATE_tuxbox-common ?= "20090305"
SRCDATE_tuxbox-libs ?= "20040928"
SRCDATE_libtuxbox ?= "20040928"
SRCDATE_tuxcom-enigma2 ?= "20060123"
SRCDATE_tuxbox-plugins ?= "20090601"
SRCDATE_dvbsnoop ?= "20081001"
SRCDATE_inadyn-mt ?= "20100519"

# dm7025
SRCDATE_squashfs-tools-native = "20100319"

# others
SRCDATE_enigma2-plugin-extensions-xmltvimport-rytec ?= "20120529"
SRCDATE_enigma2-plugin-picons-sat ?= "20110907"
SRCDATE_enigma2-plugin-picons-ziggo.casema ?= "20120722"
SRCDATE_enigma2-plugin-picons-ziggo.tvhome ?= "20120504"

RYTECSETTINGS_SRCDATE ?= "20120614"
SRCDATE_enigma2-plugin-settings-rytec-13e19e23e28e ?= "${RYTECSETTINGS_SRCDATE}"
SRCDATE_enigma2-plugin-settings-rytec-motor ?= "${RYTECSETTINGS_SRCDATE}"

HENKSAT_GITREV ?= "${AUTOREV}"
SRCREV_pn-enigma2-plugin-settings-henksat-19e ?= "${HENKSAT_GITREV}"
SRCREV_pn-enigma2-plugin-settings-henksat-13e-19e ?= "${HENKSAT_GITREV}"
SRCREV_pn-enigma2-plugin-settings-henksat-19e-23e ?= "${HENKSAT_GITREV}"
SRCREV_pn-enigma2-plugin-settings-henksat-19e-23e-28e ?= "${HENKSAT_GITREV}"
SRCREV_pn-enigma2-plugin-settings-henksat-13e-19e-23e-28e ?= "${HENKSAT_GITREV}"
SRCREV_pn-enigma2-plugin-settings-henksat-wavefrontier ?= "${HENKSAT_GITREV}"
SRCREV_pn-enigma2-plugin-settings-henksat-rotating ?= "${HENKSAT_GITREV}"
SRCREV_pn-enigma2-plugin-settings-henksat-13e-19e-23e-28e-4.8e-0.8w ?= "${HENKSAT_GITREV}"
SRCREV_pn-enigma2-plugin-settings-henksat-13e-19e-23e-28e-42e-7e ?= "${HENKSAT_GITREV}"

HANS_GITREV ?= "${AUTOREV}"
SRCREV_pn-enigma2-plugin-settings-hans-19e-23e ?= "${HANS_GITREV}"
SRCREV_pn-enigma2-plugin-settings-hans-13e-19e-23e-28e ?= "${HANS_GITREV}"
SRCREV_pn-enigma2-plugin-settings-hans-13e-19e-23e-28e-rotating ?= "${HANS_GITREV}"
```

## conf/distro/openpli.conf
```bitbake
#@TYPE: Distribution
#@NAME: OpenPLi
#@DESCRIPTION: Embedded Linux Distribution Configuration for STB's

DISTRO_NAME ?= "openpli"
DISTRO_VERSION = "2.1"
DISTRO_TYPE ?= "release"

PLISVNURL ?= "svn://openpli.svn.sourceforge.net/svnroot/openpli"
PLISVNPROTO ?= "https"
PLISVNBRANCH ?= "trunk"

# Use bluetooth 4.0
DISTRO_BLUETOOTH_MANAGER = "bluez4"
# We want images supporting the following features (for task-base)
DISTRO_FEATURES = "nfs smbfs wifi madwifi nl80211 ext2 vfat ipv4 ipv6 usbhost alsa pci"
DISTRO_FEATURES += "largefile"
# Following features are for ARM and E500 based machines
DISTRO_FEATURES += "eabi"

# The following feature enables the MIPS ABI PLT extensions
# This feature needs GCC 4.4 binutils 2.19 or glibc/eglibc 2.9
# or higher

DISTRO_FEATURES += "mplt"

INHERIT += "debian"
INHERIT += "packaged-staging"
INHERIT += "package_ipk"

IMAGE_FSTYPES ?= "jffs2"
PREFERRED_PKG_FORMAT ?= "ipk"

IPKG_VARIANT = "opkg"

FEED_NAME ?= "${DISTRO_NAME}-${DISTRO_VERSION}"
DISTRO_FEED_URI ?= "http://downloads.pli-images.org/feeds/${FEED_NAME}/${MACHINE}"
DISTRO_FEED_PREFIX = "openpli"

DISTRO_DEV_MANAGER = "busybox-mdev"
IMAGE_DEV_MANAGER = "busybox-mdev"

PREFERRED_PROVIDER_hotplug = "busybox-mdev"
HOTPLUG = "busybox-mdev"

PREFERRED_PROVIDER_inetd = "busybox-inetd"

IMAGE_LOGIN_MANAGER = "busybox"

IMAGE_NAME = "${IMAGE_BASENAME}-${DISTRO_VERSION}-${MACHINE}"
CACHE ?= "${TMPDIR}/cache/${LIBC}/${MACHINE}"
DEPLOY_DIR ?= "${TMPDIR}/deploy/${LIBC}"
DEPLOY_DIR_IMAGE = "${DEPLOY_DIR}/images/${MACHINE}"

KERNEL = "kernel26"
MACHINE_KERNEL_VERSION = "2.6"

LIBC ?= "eglibc"
PREFERRED_GCC_VERSION ?= "4.4.4"

require conf/distro/include/sane-toolchain.inc

require conf/distro/include/openpli-unstable-versions.inc

PREFERRED_PROVIDER_opkg ?= "opkg"
PREFERRED_PROVIDER_virtual/update-alternatives ?= "opkg"

PREFERRED_PROVIDER_libfribidi = "libfribidi"
PREFERRED_VERSION_libsigc++-1.2 ?= "1.2.5"
# higher versions drag in mm-common, which drags in glib -> gtk+ -> x11
PREFERRED_VERSION_libsigc++-2.0 ?= "2.2.2"
PREFERRED_VERSION_swig-native ?= "1.3.39"
PREFERRED_VERSION_glib-2.0 ?= "2.26.1"
# avoid libdlna --> ffmpeg dependency
PREFERRED_VERSION_ushare ?= "1.1a"

PREFERRED_VERSION_samba ?= "3.5.6"

# amBX won't work with libusb-compat, needs the real thing
PREFERRED_PROVIDER_virtual/libusb0 = "libusb"

# distro-feed-configs: configuration files for the online feeds
# util-linux-ng-mount util-linux-ng-umount: busybox mount is broken
# angstrom-libc-fixup-hack: fixes an obscure bug with libc.so symlink
DISTRO_EXTRA_RDEPENDS += "\
  distro-feed-configs \
  3rd-party-feed-configs \
  angstrom-libc-fixup-hack \
"

# Additional content (can be masked with BAD_RECOMMENDATIONS)
DISTRO_EXTRA_RRECOMMENDS += " \
    kernel-module-af-packet \
"
```

## conf/machine/azbox.conf
```bitbake
#@TYPE: Machine
#@NAME: AZBOX HD
#@DESCRIPTION: Machine configuration for the AZBOX HD (Elite Premium Premium+ Ultra)

PREFERRED_VERSION_linux-azbox = "2.6.22.19-25"
PREFERRED_VERSION_linux-libc-headers = "2.6.22"
PREFERRED_VERSION_wpa-supplicant = "0.4.9"
PREFERRED_VERSION_madwifi-ng = "r3314-20080131"
#take care when you do changes on MACHINE_ESSENTIAL_EXTRA_RDEPENDS/RRECOMMENDS you have to increment the recipes/tasks/task-boot.bb PR

MACHINE_ESSENTIAL_EXTRA_RDEPENDS = "\
	azbox-dvb-modules \
	kernel-module-scsi-wait-scan \
"

IMAGE_CMD_cramfs = "\
	mkcramfs ${IMAGE_ROOTFS} ${DEPLOY_DIR_IMAGE}/${IMAGE_NAME}.cramfs ${EXTRA_IMAGECMD}; \
	e2_packer ${DEPLOY_DIR_IMAGE}/${IMAGE_NAME}.cramfs ${IMAGE_ROOTFS}/boot/zbimage-linux-xrpc ${DEPLOY_DIR_IMAGE}/${IMAGE_NAME}.e2 SIFTeam koala koala koala RTi;\
	#e2_packer ${DEPLOY_DIR_IMAGE}/${IMAGE_NAME}.cramfs ${IMAGE_ROOTFS}/boot/zbimage-linux-xrpc ${DEPLOY_DIR_IMAGE}/${IMAGE_NAME}.e2 SIFTeam ${IMAGE_VERSION} ${IMAGE_BASENAME} ${IMAGE_BASENAME} RTi;\
	cd ${DEPLOY_DIR_IMAGE} && zip ${DEPLOY_DIR_IMAGE}/${IMAGE_NAME}.zip ${IMAGE_NAME}.e2; \
"

EXTRA_IMAGEDEPENDS += "azbox-build-e2-patch"

IMAGE_FSTYPES += "cramfs"

MACHINE_FEATURES += "kernel26 alsa pci wifiusblegacy wifi"

PREFERRED_PROVIDER_task-opendreambox-dvbapi = "task-opendreambox-dvbapi3"
PREFERRED_PROVIDER_task-opendreambox-ui = "task-opendreambox-enigma2"

require conf/machine/include/tune-mips32.inc
require conf/machine/include/azbox-mipsel.inc
BBMASK = "/ambx"
```

## conf/machine/azboxhd.conf
```bitbake
#@TYPE: Machine
#@NAME: Azbox HD
#@DESCRIPTION: Machine configuration for the Azbox HD


#take care when you do changes on MACHINE_ESSENTIAL_EXTRA_RDEPENDS/RRECOMMENDS you have to increment the recipes/tasks/task-boot.bb PR
MACHINE_ESSENTIAL_EXTRA_RDEPENDS += "azbox-dvb-modules \				 
				     kernel-module-tun \
				     kernel-module-pl2303 \				    
				     kernel-module-option \
				     kernel-module-cifs \
				     kernel-module-nfs \
				     kernel-module-rt61pci \
				     rt61-firmware \
				    "

DVBPROVIDER = "kernel"


module_autoload_cifs = "cifs"
module_autoload_nfs = "nfs"
module_autoload_nfd = "nfd"
module_autoload_tun = "tun"
module_autoload_pl2303 = "pl2303"
module_autoload_option = "usb_wwan \
			  option"

###  Wifi ###
module_autoload_ath9k_htc = "ath9k_htc"
module_autoload_ath9k = "ath9k"
module_autoload_carl9170 = "carl9170"
module_autoload_prism2_usb = "prism2_usb"
module_autoload_rt73usb = "rt73usb"
module_autoload_rt61pci = "rt61pci"
module_autoload_rt2500usb = "rt2500usb"
module_autoload_rt2800usb = "rt2800usb"
module_autoload_r8192u_usb = "r8192u_usb"
module_autoload_rtl8192cu = "rtl8192cu"
module_autoload_rtl8187 = "rtl8187"
module_autoload_r8712u = "r8712u"
module_autoload_w35und = "w35und"
module_autoload_zd1211rw = "zd1211rw"


EXTRA_IMAGEDEPENDS += "azbox-hd-buildimage"

MACHINE_EXTRA_RRECOMMENDS += " \
	gst-plugin-dvbmediasink \			
	azbox-mrua \	
	azbox-compat \
	"

DVBMEDIASINK_CONFIG = "--with-wma --with-wmv --with-pcm"


IMAGE_FSTYPES = "tar.bz2 cramfs"


IMAGE_CMD_cramfs = "\
	cp ${IMAGE_ROOTFS}/boot/zbimage-linux-xload ${DEPLOY_DIR_IMAGE}; \
	rm -- ${IMAGE_ROOTFS}/boot/zbimage-linux-xload; \	
	rm -rf ${IMAGE_ROOTFS}/boot/*; \
	mkcramfs ${IMAGE_ROOTFS} ${DEPLOY_DIR_IMAGE}/${IMAGE_NAME}.cramfs ${EXTRA_IMAGECMD}; \
	pack_e2 -t RTi_Team \
	-d OpenAzbox \
	-a Enigma2 \
	-v 1.0.0 \
	-i ${DEPLOY_DIR_IMAGE}/${IMAGE_NAME}.cramfs \
	-k ${DEPLOY_DIR_IMAGE}/zbimage-linux-xload -K 3.4.4 \
	-p ${DEPLOY_DIR_IMAGE}/patch.e2; \
	cd ${DEPLOY_DIR_IMAGE} && zip ${DEPLOY_DIR_IMAGE}/${IMAGE_NAME}.zip patch.e2; \
	rm -f ${DEPLOY_DIR_IMAGE}/*.bin; \
	rm -f ${DEPLOY_DIR_IMAGE}/*.tgz; \
	rm -f ${DEPLOY_DIR_IMAGE}/zbimage-linux-xload \
"

TARGET_FPU = "soft"
TARGET_ARCH = "mipsel"

MACHINE_FEATURES += "kernel26 alsa usbhost wifi nl80211"
MACHINE_FEATURES += "3dtv switchoff lpcm textlcd 32bpp hdtv dvbapi5 dvb-c blindscan-dvbs"

MACHINE_KERNEL_PR = "r0"

PREFERRED_VERSION_linux-libc-headers = "2.6.31"

PREFERRED_VERSION_mtd-utils = "1.4.6"
PREFERRED_VERSION_mtd-utils-native = "1.4.6"

GLIBC_EXTRA_OECONF = "--with-tls"

PREFERRED_PROVIDER_virtual/kernel = "linux-azbox"
PREFERRED_PROVIDER_virtual/showiframe = "azbox-dvb-tools"
PREFERRED_PROVIDER_virtual/blindscan-dvbs = "azbox-blindscan-dvbs-utils"


require conf/machine/include/tune-mips32.inc
include conf/machine/include/autoload-usbserial.inc

SYSVINIT_ENABLED_GETTYS = ""
```

## conf/machine/azboxme.conf
```bitbake
#@TYPE: Machine
#@NAME: AzBox ME
#@DESCRIPTION: Machine configuration for the AzBox ME

PREFERRED_VERSION_linux-azboxme = "2.6.22"
PREFERRED_VERSION_linux-libc-headers = "2.6.22"
PREFERRED_VERSION_wpa-supplicant = "0.4.9"
PREFERRED_VERSION_madwifi-ng = "r3314-20080131"

#take care when you do changes on MACHINE_ESSENTIAL_EXTRA_RDEPENDS/RRECOMMENDS you have to increment the recipes/tasks/task-boot.bb PR

MACHINE_ESSENTIAL_EXTRA_RDEPENDS = "\
	azboxme-dvb-modules \
"

IMAGE_NAME = AZboxMe-E2-${DATETIME}

IMAGE_CMD_jffs2 = "\
	mkfs.jffs2 \
		--root=${IMAGE_ROOTFS} \
		--faketime \
		-X zlib \
		-x lzo \
		-x rtime \
		--eraseblock=0x20000 \
		--pagesize=0x800 \
		-l \
		-p \
		-v \
		-n \
		--output=${DEPLOY_DIR_IMAGE}/flash.jffs2; \
		cd ${DEPLOY_DIR_IMAGE}; \
		tar -cvf ${DEPLOY_DIR_IMAGE}/${IMAGE_NAME}.img flash.jffs2 -C ${DEPLOY_DIR_IMAGE}/; \
		rm -rf ${DEPLOY_DIR_IMAGE}/flash.jffs2; \
		zip ${IMAGE_NAME}-${DATETIME}.zip ${IMAGE_NAME}.img; \
		rm -rf ${DEPLOY_DIR_IMAGE}/${IMAGE_NAME}.img; \
"

IMAGE_FSTYPES = "jffs2"

require conf/machine/include/azboxme.inc
```

## conf/machine/azboxminime.conf
```bitbake
#@TYPE: Machine
#@NAME: Azbox MiniMe
#@DESCRIPTION: Machine configuration for the Azbox MiniMe


#take care when you do changes on MACHINE_ESSENTIAL_EXTRA_RDEPENDS/RRECOMMENDS you have to increment the recipes/tasks/task-boot.bb PR
MACHINE_ESSENTIAL_EXTRA_RDEPENDS += "azbox-dvb-modules \				 
				     kernel-module-tun \
				     kernel-module-pl2303 \				    
				     kernel-module-option \
				     kernel-module-cifs \
				     kernel-module-nfs \
				    "

DVBPROVIDER = "kernel"

module_autoload_cifs = "cifs"
module_autoload_nfs = "nfs"
module_autoload_nfd = "nfd"
module_autoload_tun = "tun"
module_autoload_pl2303 = "pl2303"
module_autoload_option = "usb_wwan \
			  option"


###  Wifi ###
module_autoload_ath9k_htc = "ath9k_htc"
module_autoload_ath9k = "ath9k"
module_autoload_carl9170 = "carl9170"
module_autoload_prism2_usb = "prism2_usb"
module_autoload_rt73usb = "rt73usb"
module_autoload_rt2500usb = "rt2500usb"
module_autoload_rt2800usb = "rt2800usb"
module_autoload_r8192u_usb = "r8192u_usb"
module_autoload_rtl8192cu = "rtl8192cu"
module_autoload_rtl8187 = "rtl8187"
module_autoload_r8712u = "r8712u"
module_autoload_w35und = "w35und"
module_autoload_zd1211rw = "zd1211rw"



MACHINE_EXTRA_RRECOMMENDS += " \
	gst-plugin-dvbmediasink \			
	azbox-mrua \	
	azbox-compat \
	"

DVBMEDIASINK_CONFIG = "--with-wma --with-wmv --with-pcm"

KERNEL_EXTRA_CMD = "--disable-compressor=lzo "

EXTRA_IMAGECMD_jffs2 = " -p 0x800 -e 0x20000 -n -l"
IMAGE_CMD_jffs2 = "\
	cp ${IMAGE_ROOTFS}/boot/zbimage-linux-xload ${DEPLOY_DIR_IMAGE}; \
	rm -- ${IMAGE_ROOTFS}/boot/zbimage-linux-xload; \	
	rm -rf ${IMAGE_ROOTFS}/boot/*; \
	mkfs.jffs2 \
		--root=${IMAGE_ROOTFS} \
		--faketime \
		${KERNEL_EXTRA_CMD} \
		--compression-mode=size \
		--output=${DEPLOY_DIR_IMAGE}/image0.jffs2 \
		${EXTRA_IMAGECMD}; \	
	rm -- ${DEPLOY_DIR_IMAGE}/*.bin \
        "

TARGET_FPU = "hard"
TARGET_ARCH = "mipsel"

MACHINE_FEATURES += "kernel26 alsa usbhost wifi nl80211"
MACHINE_FEATURES += "3dtv switchoff lpcm 32bpp hdtv dvbapi5"

MACHINE_KERNEL_PR = "r0"

PREFERRED_VERSION_linux-libc-headers = "2.6.31"

PREFERRED_VERSION_mtd-utils = "1.4.6"
PREFERRED_VERSION_mtd-utils-native = "1.4.6"

GLIBC_EXTRA_OECONF = "--with-tls"

PREFERRED_PROVIDER_virtual/kernel = "linux-azbox"
PREFERRED_PROVIDER_virtual/showiframe = "azbox-dvb-tools"


require conf/machine/include/tune-mips32.inc
include conf/machine/include/autoload-usbserial.inc

SYSVINIT_ENABLED_GETTYS = ""
```
