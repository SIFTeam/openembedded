## conf/machine/dm8000.conf
```bitbake
#@TYPE: Machine
#@NAME: Dreambox DM 8000 HD PVR
#@DESCRIPTION: Machine configuration for the Dreambox DM 8000 HD PVR

#needed for wpa-supplicant
COMBINED_FEATURES_append = "${@base_contains('PREFERRED_VERSION_linux-${MACHINE}', '2.6.18', 'madwifi', 'nl80211', d)}"

#take care when you do changes on MACHINE_ESSENTIAL_EXTRA_RDEPENDS/RRECOMMENDS you have to increment the recipes/tasks/task-boot.bb PR

MACHINE_ESSENTIAL_EXTRA_RDEPENDS = "\
	kernel-module-dvb-core \
	kernel-module-stv0299 \
	kernel-module-fb \
	kernel-module-snd-pcm \
	kernel-module-snd \
	kernel-module-nls-iso8859-1 \
	kernel-module-nls-iso8859-15 \
	kernel-module-nls-cp437 \
	kernel-module-nls-cp850 \
	kernel-module-nls-utf8 \
"

module_autoload_stv0299 = "stv0299"
module_autoload_nls-iso8859-1 = "nls-iso8859-1"
module_autoload_nls-iso8859-15 = "nls-iso8859-15"
module_autoload_nls-cp437 = "nls-cp437"
module_autoload_nls-cp850 = "nls-cp850"
module_autoload_nls-utf8 = "nls-utf8"

MACHINE_ESSENTIAL_EXTRA_RRECOMMENDS = "\
	kernel-module-cifs \
	kernel-module-exportfs \
	kernel-module-ext2 \
	kernel-module-xfs \
	kernel-module-iso9660 \
	kernel-module-udf \
	kernel-module-cdfs \
"

module_autoload_cifs = "cifs"
module_autoload_exportfs = "exportfs"
module_autoload_ext2 = "ext2"
module_autoload_xfs = "xfs"
module_autoload_iso9660 = "iso9660"
module_autoload_udf = "udf"
module_autoload_cdfs = "cdfs"
module_autoload_ntfs = "ntfs"

MACHINE_EXTRA_RRECOMMENDS = " \
	gst-plugin-dvbmediasink \
	dreambox-tpmd \
	dreambox-keymaps \
	"

KERNEL_EXTRA_CMD = "--disable-compressor=lzo "

EXTRA_IMAGECMD_jffs2 = " --eraseblock=0x20000 -n -l "
IMAGE_CMD_jffs2 = "\
	mkfs.jffs2 \
		--root=${IMAGE_ROOTFS}/boot \
		--faketime \
		--disable-compressor=lzo \
		--compression-mode=size \
		--output=${DEPLOY_DIR_IMAGE}/${IMAGE_NAME}.boot.jffs2 \
		${EXTRA_IMAGECMD}; \
	rm -rf ${IMAGE_ROOTFS}/boot/*; \
	mkfs.jffs2 \
		--root=${IMAGE_ROOTFS} \
		--faketime \
		${KERNEL_EXTRA_CMD} \
		--compression-mode=size \
		--output=${DEPLOY_DIR_IMAGE}/${IMAGE_NAME}.rootfs.jffs2 \
		${EXTRA_IMAGECMD}; \
	buildimage ${STAGING_LIBDIR}/dreambox-secondstage/main.bin.gz \
		${DEPLOY_DIR_IMAGE}/${IMAGE_NAME}.boot.jffs2 \
		${DEPLOY_DIR_IMAGE}/${IMAGE_NAME}.rootfs.jffs2 \
		${MACHINE} 64 large \
		> ${DEPLOY_DIR_IMAGE}/${IMAGE_NAME}.nfi"

TARGET_FPU = "hard"

MACHINE_FEATURES += "usbhost wifi"

# openpli specific features:
MACHINE_FEATURES += "32bpp hdtv switchoff lpcm dvb-c frontprocessor blindscan"

require conf/machine/include/dreambox-mipsel.inc
include conf/machine/include/autoload-usbserial.inc
```

## conf/machine/gb800ue.conf
```bitbake
#@TYPE: Machine
#@NAME: Gigablue 
#@DESCRIPTION: Machine configuration for the GigaBlue HD 800 UE

#take care when you do changes on MACHINE_ESSENTIAL_EXTRA_RDEPENDS/RRECOMMENDS you have to increment the recipes/tasks/task-boot.bb PR

MACHINE_ESSENTIAL_EXTRA_RDEPENDS += "gb800se-dvb-modules \
	kernel-module-nls-cp850 \
	"

module_autoload_nls-cp850 = "nls-cp850"

# WIFI modules
module_autoload_ath9k_htc = "ath9k_htc"
module_autoload_carl9170 = "carl9170"
module_autoload_prism2_usb = "prism2_usb"
module_autoload_rt73usb = "rt73usb"
module_autoload_rt2500usb = "rt2500usb"
module_autoload_rt2800usb = "rt2800usb"
module_autoload_r8192u_usb = "r8192u_usb"
module_autoload_rtl8192cu = "rtl8192cu"
module_autoload_rtl8187 = "rtl8187"
module_autoload_r8712u = "r8712u"
module_autoload_w35und = "w35und"
module_autoload_zd1211rw = "zd1211rw"

# DVB modules
module_autoload_em28xx-dvb = "em28xx-dvb"
module_autoload_dvb-as102 = "dvb-as102"
module_autoload_dvb-usb-a800 = "dvb-usb-a800"
module_autoload_dvb-usb-a867 = "dvb-usb-a867"
module_autoload_dvb-usb-af9005 = "dvb-usb-af9005"
module_autoload_dvb-usb-af9015 = "dvb-usb-af9015"
module_autoload_dvb-usb-af9035 = "dvb-usb-af9035"
module_autoload_dvb-usb-anysee = "dvb-usb-anysee"
module_autoload_dvb-usb-au6610 = "dvb-usb-au6610"
module_autoload_dvb-usb-az6027 = "dvb-usb-az6027"
module_autoload_dvb-usb-ce6230 = "dvb-usb-ce6230"
module_autoload_dvb-usb-cxusb = "dvb-usb-cxusb"
module_autoload_dvb-usb-cinergyT2 = "dvb-usb-cinergyT2"
module_autoload_dvb-usb-digitv = "dvb-usb-digitv"
module_autoload_dvb-usb-dib0700 = "dvb-usb-dib0700"
module_autoload_dvb-usb-dibusb-mb = "dvb-usb-dibusb-mb"
module_autoload_dvb-usb-dibusb-mc = "dvb-usb-dibusb-mc"
module_autoload_dvb-usb-dtv5100 = "dvb-usb-dtv5100"
module_autoload_dvb-usb-dtt200u = "dvb-usb-dtt200u"
module_autoload_dvb-usb-dw2102 = "dvb-usb-dw2102"
module_autoload_dvb-usb-ec168 = "dvb-usb-ec168"
module_autoload_dvb-usb-friio = "dvb-usb-friio"
module_autoload_dvb-usb-gl861 = "dvb-usb-gl861"
module_autoload_dvb-usb-gp8psk = "dvb-usb-gp8psk"
module_autoload_dvb-usb-it9135 = "dvb-usb-it9135"
module_autoload_dvb-usb-m920x = "dvb-usb-m920x"
module_autoload_dvb-usb-opera = "dvb-usb-opera"
module_autoload_dvb-usb-rtl2832 = "dvb-usb-rtl2832"
module_autoload_dvb-usb-technisat-usb2 = "dvb-usb-technisat-usb2"
module_autoload_dvb-usb-ttusb2 = "dvb-usb-ttusb2"
module_autoload_dvb-ttusb-budget = "dvb-ttusb-budget"
module_autoload_dvb-usb-nova-t-usb2 = "dvb-usb-nova-t-usb2"
module_autoload_dvb-usb-umt-010 = "dvb-usb-umt-010"
module_autoload_dvb-usb-vp702x = "dvb-usb-vp702x" 
module_autoload_dvb-usb-vp7045 = "dvb-usb-vp7045"
module_autoload_smsusb = "smsdvb smsusb"


MACHINE_ESSENTIAL_EXTRA_RRECOMMENDS = "\
	kernel-module-exportfs \
"

module_autoload_exportfs = "exportfs"

MACHINE_EXTRA_RRECOMMENDS = " \
	gst-plugin-dvbmediasink \
	gb800xx-cfe \
	ntfs-3g \
	"

IMAGE_FSTYPES ?= "ubi"

UBI_VOLNAME = "rootfs"
MKUBIFS_ARGS = "-m 2048 -e 126976 -c 4096"
UBINIZE_ARGS = "-m 2048 -p 128KiB"

IMAGEDIR ?= "${MACHINE}"

IMAGE_CMD_ubi_append = "; \
	mkdir -p ${DEPLOY_DIR_IMAGE}/${IMAGEDIR}/gigablue/se; \
	cp ${DEPLOY_DIR_IMAGE}/${IMAGE_NAME}.rootfs.ubi ${DEPLOY_DIR_IMAGE}/${IMAGEDIR}/gigablue/se/rootfs.bin; \
	gzip -c ${DEPLOY_DIR_IMAGE}/vmlinux-${MACHINE}.bin > ${DEPLOY_DIR_IMAGE}/${IMAGEDIR}/gigablue/se/kernel.bin; \
	echo ${DISTRO_NAME}-${DISTRO_VERSION}-${DATE} > ${DEPLOY_DIR_IMAGE}/${IMAGEDIR}/gigablue/se/imageversion; \
	echo "rename this file to 'force' to force an update without confirmation" > ${DEPLOY_DIR_IMAGE}/${IMAGEDIR}/gigablue/se/noforce; \
	cp ${DEPLOY_DIR_IMAGE}/burn.bat ${DEPLOY_DIR_IMAGE}/${IMAGEDIR}/burn.bat; \
	cd ${DEPLOY_DIR_IMAGE}/${IMAGEDIR}; \
	zip -r ${DISTRO_NAME}-${DISTRO_VERSION}-${MACHINE}-${DATE}_usb.zip *; \
	cd ${DEPLOY_DIR_IMAGE}; \
	rm -Rf ${IMAGEDIR}; \
	"

DVBPROVIDER = "kernel"

TARGET_FPU = "hard"

TARGET_ARCH = "mipsel"

MACHINE_FEATURES += "kernel26 alsa usbhost colorlcd wifi nl80211"

# openpli specific features:
MACHINE_FEATURES += "32bpp hdtv switchoff lpcm dvbapi5 3dtv dvb-c"

CHIPSET = "bcm7325"

MACHINE_KERNEL_PR = "r4"

PREFERRED_VERSION_linux-gb800xx = "3.1.1"
PREFERRED_VERSION_linux-libc-headers = "2.6.31"

TARGET_ARCH = "mipsel"

GLIBC_EXTRA_OECONF = "--with-tls"

PREFERRED_PROVIDER_virtual/kernel = "linux-gb800xx"

PREFERRED_PROVIDER_virtual/showiframe = "vuplus-dvb-tools"

require conf/machine/include/tune-mips32.inc

include conf/machine/include/autoload-usbserial.inc

SYSVINIT_ENABLED_GETTYS = ""
```

## conf/machine/include/azbox-mipsel.inc
```bitbake
# azbox-mipsel.inc

MACHINE_FEATURES += "alsa"

#MACHINE_KERNEL_PR = "r6"

PREFERRED_VERSION_linux-${MACHINE} = "2.6.22.19"
PREFERRED_VERSION_linux-libc-headers = "2.6.22"

TARGET_ARCH = "mipsel"
TARGET_FPU ?= "soft"

#DISTRO_FEATURES = "nfs smbfs wifi nl80211 ext2 vfat ipv4 ipv6 usbhost alsa pci mplt"
DISTRO_FEATURES = " ext2 vfat ipv4 usbhost alsa pci mplt"

PREFERRED_PROVIDER_virtual/kernel = "linux-${MACHINE}"
PREFERRED_PROVIDER_xserver = "xserver-kdrive"


GLIBC_ADDONS ?= "ports,nptl,libidn"
GLIBC_EXTRA_OECONF ?= "--disable-profile --with-tls --without-fp --with-__thread"
```

## conf/machine/include/azbox.inc
```bitbake
# dreambox.inc

EXTRA_IMAGEDEPENDS += "dreambox-secondstage dreambox-buildimage-native"

MACHINE_ESSENTIAL_EXTRA_RDEPENDS += "dreambox-dvb-modules"

MACHINE_FEATURES += "kernel26"

# openpli specific features:
MACHINE_FEATURES += "dreambox"

PREFERRED_PROVIDER_virtual/kernel = "linux-${MACHINE}"
PREFERRED_PROVIDER_xserver = "xserver-kdrive"

DISTRO_FEATURES = "nfs smbfs wifi nl80211 ext2 vfat ipv4 ipv6 usbhost alsa pci"
```

## conf/machine/include/azboxhd.inc
```bitbake
# azboxhd.inc

MACHINE_FEATURES += "wifi alsa pci kernel26 usbhost nl80211 wifiusblegacy hdtv textlcd"

TARGET_ARCH = "mipsel"
TARGET_FPU ?= "soft"

DISTRO_FEATURES += " mplt"

EXTRA_IMAGEDEPENDS += "azboxhd-buildimage"

GLIBC_ADDONS ?= "ports,nptl,libidn"
GLIBC_EXTRA_OECONF ?= "--disable-profile --with-tls --without-fp --with-__thread"

#MACHINE_ESSENTIAL_EXTRA_RDEPENDS += "azboxhd-dvb-modules"
MACHINE_FEATURES += "kernel26 textlcd"

PREFERRED_PROVIDER_virtual/kernel = "linux-${MACHINE}"
PREFERRED_PROVIDER_xserver = "xserver-kdrive"
PREFERRED_PROVIDER_virtual/showiframe = "dreambox-dvb-tools-v3"

require conf/machine/include/tune-mips32.inc
```

## conf/machine/include/azboxme.inc
```bitbake
# azboxme.inc

MACHINE_FEATURES += "wifi alsa pci kernel26 usbhost nl80211 wifiusblegacy"

TARGET_ARCH = "mipsel"
TARGET_FPU ?= "soft"

DISTRO_FEATURES += " mplt"

GLIBC_ADDONS ?= "ports,nptl,libidn"
GLIBC_EXTRA_OECONF ?= "--disable-profile --with-tls --without-fp --with-__thread"

MACHINE_FEATURES += "kernel26"

PREFERRED_PROVIDER_virtual/kernel = "linux-${MACHINE}"
PREFERRED_PROVIDER_xserver = "xserver-kdrive"

require conf/machine/include/tune-mips32.inc
```

## conf/machine/include/dreambox-mipsel.inc
```bitbake
# dreambox-mipsel.inc

MACHINE_FEATURES += "alsa"

MACHINE_KERNEL_PR = "r6"

PREFERRED_VERSION_linux-${MACHINE} = "2.6.18"
PREFERRED_VERSION_linux-libc-headers = "2.6.18"

PREFERRED_VERSION_mtd-utils = "1.1.0"

PREFERRED_VERSION_madwifi-ng = "r3314-20080131"

PREFERRED_PROVIDER_virtual/showiframe = "dreambox-dvb-tools-v3"

OLDEST_KERNEL = "2.6.12"

TARGET_ARCH = "mipsel"
TARGET_FPU ?= "soft"

GLIBC_EXTRA_OECONF = "--with-tls"

require conf/machine/include/dreambox.inc
require conf/machine/include/tune-mips32.inc
```

## conf/machine/include/dreambox-powerpc.inc
```bitbake
# dreambox-powerpc.inc

OLDEST_KERNEL = "2.6.9"

PREFERRED_VERSION_gdb = "6.5"
PREFERRED_VERSION_gdb-cross = "6.5"
PREFERRED_VERSION_freetype = "2.0.9"
PREFERRED_PROVIDER_task-opendreambox-dvbapi = "task-opendreambox-dvbapi2"
PREFERRED_PROVIDER_task-opendreambox-ui = "task-opendreambox-enigma"

TARGET_ARCH = "powerpc"
TARGET_CPU = "405"

EXTRA_IMAGECMD_jffs2 = " --eraseblock=0x4000 -n -b "
IMAGE_CMD_jffs2 = "mkfs.jffs2 --root=${IMAGE_ROOTFS}/boot --faketime -x lzo \
       --output=${DEPLOY_DIR_IMAGE}/${IMAGE_NAME}.boot.jffs2 \
       ${EXTRA_IMAGECMD}; rm -rf ${IMAGE_ROOTFS}/boot/*; \
				mkfs.jffs2 --root=${IMAGE_ROOTFS} --faketime -x lzo \
       --output=${DEPLOY_DIR_IMAGE}/${IMAGE_NAME}.rootfs.jffs2 \
       ${EXTRA_IMAGECMD}; \
       buildimage ${STAGING_LIBDIR}/dreambox-secondstage/main.bin.gz \
       ${DEPLOY_DIR_IMAGE}/${IMAGE_NAME}.boot.jffs2 \
       ${DEPLOY_DIR_IMAGE}/${IMAGE_NAME}.rootfs.jffs2 \
       ${MACHINE} \
       > ${DEPLOY_DIR_IMAGE}/${IMAGE_NAME}.nfi"

require conf/machine/include/dreambox.inc
require conf/machine/include/tune-ppc405.inc
```

## conf/machine/include/dreambox.inc
```bitbake
# dreambox.inc

EXTRA_IMAGEDEPENDS += "dreambox-secondstage dreambox-buildimage-native"

MACHINE_ESSENTIAL_EXTRA_RDEPENDS += "dreambox-dvb-modules"

MACHINE_FEATURES += "kernel26"

# openpli specific features:
MACHINE_FEATURES += "dreambox"

PREFERRED_PROVIDER_virtual/kernel = "linux-${MACHINE}"
PREFERRED_PROVIDER_xserver = "xserver-kdrive"
```

## conf/machine/quattro.conf
```bitbake
#@TYPE: Machine
#@NAME: Gigablue 
#@DESCRIPTION: Machine configuration for the GigaBlue HD Quattro

#take care when you do changes on MACHINE_ESSENTIAL_EXTRA_RDEPENDS/RRECOMMENDS you have to increment the recipes/tasks/task-boot.bb PR

MACHINE_ESSENTIAL_EXTRA_RDEPENDS += "quattro-dvb-modules \
	kernel-module-nls-cp850 \
	kernel-module-ext2 \
	kernel-module-ext3 \
	"

module_autoload_ext2 = "ext2"
module_autoload_ext3 = "ext3"
module_autoload_nls-cp850 = "nls-cp850"


MACHINE_EXTRA_RRECOMMENDS = " \
	gst-plugin-gbmediasink \
	"

IMAGE_FSTYPES ?= "ubi"

UBI_VOLNAME = "rootfs"
MKUBIFS_ARGS = "-m 2048 -e 126976 -c 1978"
UBINIZE_ARGS = "-m 2048 -p 128KiB"

IMAGEDIR ?= "${MACHINE}"

IMAGE_CMD_ubi_append = "; \
	mkdir -p ${DEPLOY_DIR_IMAGE}/${IMAGEDIR}/gigablue/quad; \
	cp ${DEPLOY_DIR_IMAGE}/splash.bin ${DEPLOY_DIR_IMAGE}/${IMAGEDIR}/gigablue/quad/splash.bin; \
	cp ${DEPLOY_DIR_IMAGE}/lcdsplash.bin ${DEPLOY_DIR_IMAGE}/${IMAGEDIR}/gigablue/quad/lcdsplash.bin; \
	cp ${DEPLOY_DIR_IMAGE}/${IMAGE_NAME}.rootfs.ubi ${DEPLOY_DIR_IMAGE}/${IMAGEDIR}/gigablue/quad/rootfs.bin; \
	gzip -c ${DEPLOY_DIR_IMAGE}/vmlinux-${MACHINE}.bin > ${DEPLOY_DIR_IMAGE}/${IMAGEDIR}/gigablue/quad/kernel.bin; \
	echo ${DISTRO_NAME}-${DISTRO_VERSION}-${DATE} > ${DEPLOY_DIR_IMAGE}/${IMAGEDIR}/gigablue/quad/imageversion; \
	echo "rename this file to 'force' to force an update without confirmation" > ${DEPLOY_DIR_IMAGE}/${IMAGEDIR}/gigablue/quad/noforce; \
	cd ${DEPLOY_DIR_IMAGE}/${IMAGEDIR}; \
	zip -r ${DEPLOY_DIR_IMAGE}/${DISTRO_NAME}-${DISTRO_VERSION}-${MACHINE}-${DATE}_usb.zip *; \
	cd ${DEPLOY_DIR_IMAGE}; \
	rm -Rf ${IMAGEDIR}; \
	"

DVBPROVIDER = "kernel"

TARGET_FPU = "hard"

TARGET_ARCH = "mipsel"

MACHINE_FEATURES += "kernel26 alsa usbhost colorlcd"

# openpli specific features:
MACHINE_FEATURES += "32bpp hdtv switchoff lpcm dvbapi5 3dtv dvb-c gigablue"

CHIPSET = "bcm7346"

MACHINE_KERNEL_PR = "r13"

PREFERRED_VERSION_linux-quattro = "2.6.37"
PREFERRED_VERSION_linux-libc-headers = "2.6.31"

TARGET_ARCH = "mipsel"

GLIBC_EXTRA_OECONF = "--with-tls"

PREFERRED_PROVIDER_virtual/kernel = "linux-quattro"

PREFERRED_PROVIDER_virtual/showiframe = "vuplus-dvb-tools"

require conf/machine/include/tune-mips32.inc

include conf/machine/include/autoload-usbserial.inc

SYSVINIT_ENABLED_GETTYS = ""
```

## conf/machine/vuduo.conf
```bitbake
#@TYPE: Machine
#@NAME: Vu+ Duo
#@DESCRIPTION: Machine configuration for the Vu+ Duo

UPDATE_DIR = "duo"

include vuxxo.inc

MACHINE_FEATURES += "kernel26 alsa usbhost wifi nl80211"

# openpli specific features:
MACHINE_FEATURES += "32bpp hdtv switchoff lpcm textlcd dvbapi5"

CHIPSET = "bcm7335"

MACHINE_KERNEL_PR = "r4"
```
