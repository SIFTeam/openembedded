## conf/machine/vusolo.conf
```bitbake
#@TYPE: Machine
#@NAME: Vu+ Solo
#@DESCRIPTION: Machine configuration for the Vu+ Solo

UPDATE_DIR = "solo"

include vuxxo.inc

MACHINE_FEATURES += "kernel26 alsa usbhost wifi nl80211"

# openpli specific features:
MACHINE_FEATURES += "32bpp hdtv switchoff lpcm textlcd dvbapi5"

#hack
CHIPSET = "bcm7413"

MACHINE_KERNEL_PR = "r4"
```

## conf/machine/vuultimo.conf
```bitbake
#@TYPE: Machine
#@NAME: Vu+ Ultimo
#@DESCRIPTION: Machine configuration for the Vu+ Ultimo

UPDATE_DIR = "ultimo"

include vuxxo.inc

EXTRA_IMAGEDEPENDS += "\
	enigma2-plugin-systemplugins-manualfancontrol \
	enigma2-plugin-systemplugins-firmwareupgrade \
	enigma2-plugin-systemplugins-remotecontrolcode \
	enigma2-plugin-systemplugins-ledbrightnesssetup \
	vuplus-enigma2-vfdskin \
	"

MACHINE_FEATURES += "kernel26 alsa usbhost wifi nl80211"

# openpli specific features:
MACHINE_FEATURES += "32bpp hdtv switchoff lpcm dvbapi5 satscan dvb-c"

CHIPSET = "bcm7413"

MACHINE_KERNEL_PR = "r4"

PREFERRED_PROVIDER_virtual/satscanutils = "vuplus-blindscan-utils"
```

## conf/machine/vuuno.conf
```bitbake
#@TYPE: Machine
#@NAME: Vu+ Uno
#@DESCRIPTION: Machine configuration for the Vu+ Uno

UPDATE_DIR = "uno"

include vuxxo.inc

EXTRA_IMAGEDEPENDS += "\
	enigma2-plugin-systemplugins-manualfancontrol \
	enigma2-plugin-systemplugins-fpgaupgrade \
	enigma2-plugin-systemplugins-remotecontrolcode \
"

MACHINE_FEATURES += "kernel26 alsa usbhost wifi nl80211"

# openpli specific features:
MACHINE_FEATURES += "32bpp hdtv switchoff lpcm textlcd dvbapi5 satscan dvb-c"

CHIPSET = "bcm7413"

MACHINE_KERNEL_PR = "r4"

PREFERRED_PROVIDER_virtual/satscanutils = "vuplus-blindscan-utils"
```
